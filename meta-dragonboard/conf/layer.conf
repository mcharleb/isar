## meta-dragonboard/conf/layer.conf
```bitbake
# Copyright (C) 2017 Mark Charlebois

BBPATH .= ":${LAYERDIR}"
BBFILES +=  "${LAYERDIR}/recipes-*/*/*.bb"

BBFILE_COLLECTIONS += "dragonboard"
BBFILE_PATTERN_dragonboard = "^${LAYERDIR}/"
BBFILE_PRIORITY_dragonboard = "5"

LAYERVERSION_dragonboard = "2"

LAYERDIR_dragonboard = "${LAYERDIR}"
```

## meta-dragonboard/conf/machine/410c.conf
```bitbake
# Copyright (C) 2017 Mark Charlebois

MACHINE_SERIAL ?= "ttyAMA0"
BAUDRATE_TTY ?= "115200"

IMAGE_TYPE ?= "410c-simg"
```

## meta-isar-bin/conf/layer.conf
```bitbake
# Enable package caching with '1'
DEBCACHE_ENABLED ?= "1"

# Codename of the repository created by the caching class
DEBDISTRONAME = "isar"

# Path to the caching repository
DEBCACHEDIR ?= "${LAYERDIR}/apt"
# Path to the mount point of the repository within the target rootfs, during population
DEBCACHEMNT ?= "/opt/cache/apt"

# Path to the databases used by `reprepro`
DEBDBDIR ?= "${LAYERDIR}/db"
# Path to the configuration files templates used by `reprepro`
DEBFILESDIR ?= "${LAYERDIR}/files"
```

## meta-isar/conf/machine/qemuamd64.conf
```bitbake
# This software is a part of ISAR.
# Copyright (C) 2015-2016 ilbers GmbH

IMAGE_PREINSTALL = "linux-image-amd64"
KERNEL_IMAGE = "vmlinuz-4.9.0-3-amd64"
INITRD_IMAGE = "initrd.img-4.9.0-3-amd64"

MACHINE_SERIAL = "ttyS0"
ROOTFS_DEV = "sda"
BAUDRATE_TTY = "115200"

IMAGE_TYPE = "ext4-img"
```

## meta-isar/conf/machine/qemuarm.conf
```bitbake
# This software is a part of ISAR.
# Copyright (C) 2015-2017 ilbers GmbH

IMAGE_PREINSTALL = "linux-image-armmp"

MACHINE_SERIAL = "ttyAMA0"
ROOTFS_DEV = "mmcblk0"
BAUDRATE_TTY = "9600"

IMAGE_TYPE = "ext4-img"
```

## meta-isar/conf/machine/qemui386.conf
```bitbake
# This software is a part of ISAR.
# Copyright (C) 2017 ilbers GmbH

MACHINE_SERIAL ?= "ttyS0"
BAUDRATE_TTY ?= "115200"
IMAGE_PREINSTALL ?= "linux-image-686-pae"

IMAGE_TYPE ?= "ext4-img"
```

## meta-isar/conf/machine/rpi.conf
```bitbake
# This software is a part of ISAR.
# Copyright (C) 2015-2017 ilbers GmbH

MACHINE_SERIAL ?= "ttyAMA0"
BAUDRATE_TTY ?= "9600"

KERNEL_IMAGE = "vmlinuz-4.4.0-1-rpi"
INITRD_IMAGE = "initrd.img-4.4.0-1-rpi"
IMAGE_BOOT_FILES = "boot_rpi/overlays/*;overlays/* boot_rpi/*.*"

MACHINE_SERIAL = "ttyAMA0"
ROOTFS_DEV = "mmcblk0p2"
BAUDRATE_TTY = "9600"

IMAGE_TYPE = "rpi-sdimg"
```
